## conf/distro/include/mobilext-preferred-versions.inc
```bitbake
UDEV_GE_141 = "1"

#Use the Yocto project linux-dev (which uses the mainline kernel).
PREFERRED_PROVIDER_virtual/kernel = "linux-yocto-xen"

#Try to use the lower-numbered (but apparently updated and stable)
#version of GPM.
PREFERRED_VERSION_gpm = "1.20.7"
```

## conf/distro/include/xen-support.inc
```bitbake
#
# Include for distributions with Xen support.
#

#Ensure that local QEMU builds prefer having Xen enabled.
PACKAGECONFIG_append_pn-qemu ?= "xen"
```

## conf/layer.conf
```bitbake
# We have a conf and classes directory, append to BBPATH
BBPATH .= ":${LAYERDIR}"

#Support both a traditional OE recipe-notation scheme,
#and per-device folders in the BSP directory.
BBFILES += "\
    ${LAYERDIR}/recipes*/*/*.bb \
    ${LAYERDIR}/recipes*/*/*.bbappend \
    ${LAYERDIR}/recipes-bsp/*/*/*.bb \
    ${LAYERDIR}/recipes-bsp/*/*/*.bbappend \
"

BBFILE_COLLECTIONS += "mobilext-layer"
BBFILE_PATTERN_mobilext-layer := "^${LAYERDIR}/"

#Unfortunately, some of the Yocto assets set their priorities unreasonably high.
#We'll need to participate in this arms race [=(] by setting our priority even higher.
BBFILE_PRIORITY_mobilext-layer = "50"

# Custom licenses used by some packages in this layer
LICENSE_PATH += "${LAYERDIR}/files/custom-licenses"

# This should only be incremented on significant changes that will
# cause compatibility issues with other layers
LAYERVERSION_mobilext-layer = "1"
LAYERDEPENDS_mobilext-layer = "core networking-layer virtualization-layer"
```

## conf/machine/chromebook.conf
```bitbake
#@TYPE: Machine
#@NAME: Chromebook
#@DESCRIPTION: Machine configuration for original Samsung Chromebook

# Only has DVI connector for external screen
GUI_MACHINE_CLASS = "bigscreen"

DEFAULTTUNE ?= "armv7ve"

require conf/machine/include/arm/arch-armv7ve.inc
require conf/machine/include/arm/arm-xen.inc

KERNEL_DEVICETREE = "exynos5250-snow.dtb"

UBOOT_MACHINE = "snow_config"
UBOOT_ENTRYPOINT  = "0x80200000"
UBOOT_LOADADDRESS = "0x80200000"

#TODO: Possibly relocate me (and some of the above?) to an include file?
SPL_BINARY = "u-boot-spl.bin"

#Set up the locations into which u-boot should load the kernel components.
#These are appropriate for the 1GiB of RAM on the MSI Primo 73.
#TODO: Generate me automatically!
UBOOT_DOM0_ADDR   = "0x7c600000"
UBOOT_DTB_ADDR    = "0x74c00000"
UBOOT_XEN_ADDR    = "0x72a00000"

SERIAL_CONSOLE = "115200 ttyS0"

XEN_SERIAL_PORT    = "/serial@12C20000"
XEN_DOM0_MEMORY    = "512M"
XEN_EARLYPRINTK    = "exynos5250"

DOM0_EXTRA_BOOTARGS = "console=tty1"

MACHINE_FEATURES = "screen apm usbgadget usbhost vfat"
```

## conf/machine/cubietruck-dom0.conf
```bitbake
#@TYPE: Machine
#@NAME: Cubietruck-dom0
#@DESCRIPTION: Machine configuration for the Cubietruck running Xen

# Only has DVI connector for external screen
GUI_MACHINE_CLASS = "bigscreen"

require conf/machine/include/tune-cortexa7.inc
require conf/machine/include/sunxi-xen.inc
require conf/machine/include/sunxi-mali.inc

KERNEL_DEVICETREE = "sun7i-a20-cubietruck.dtb"

UBOOT_MACHINE = "cubietruck"
UBOOT_ENTRYPOINT = "0x40008000"
UBOOT_LOADADDRESS = "0x40008000"

SERIAL_CONSOLE = "115200 ttyS0"

MACHINE_FEATURES = "screen apm usbgadget usbhost vfat"
```

## conf/machine/generic-x86_64-efi-xen.conf
```bitbake
#@TYPE: Machine
#@NAME: Generic-x86-Xen
#@DESCRIPTION: Generic machine for Xen on x86 with EFI-only firmware.

MACHINE_NAME = "Generic amd64 Target with EFI"
GUI_MACHINE_CLASS = "bigscreen"

#For now, require a Core series (Nehalem or newer) processor.
#This can easily be changed later to expand backwards compatibility,
#though there are no earlier CPUs on our compatibilty list.
require conf/machine/include/tune-corei7.inc
require conf/machine/include/x86-xen.inc

SERIAL_CONSOLE = "115200 ttyS0"

XEN_SERIAL_PORT    = "pci"
XEN_DOM0_MEMORY    = "256M"

#Not used on x86.
#XEN_EARLYPRINTK    = ""

MACHINE_FEATURES = "screen apm usbhost vfat efi"

#Assume a default root; though this should probably be
#detected and rewritten either by the installer, to
#expand compatibility to non-tablets.
DOM0_ROOT ?= "/dev/sda2"
```

## conf/machine/generic-x86_64-xen.conf
```bitbake
#@TYPE: Machine
#@NAME: Generic-x86-Xen
#@DESCRIPTION: Generic machine for Xen on x86.

#Some information about the machine, as typically used by the installer.
MACHINE_NAME = "Generic amd64 Target"
DEFAULT_INSTALLATION_DRIVE = "/dev/sda"

GUI_MACHINE_CLASS = "bigscreen"

#TODO: Should this be tune-x86_64?
require conf/machine/include/tune-x86_64.inc
require conf/machine/include/x86-xen.inc

SERIAL_CONSOLE = "115200 ttyS0"

XEN_SERIAL_PORT    = "pci"
XEN_DOM0_MEMORY    = "256M"

#Extra boot options for Linux outside of Xen.
#In MobileXT, this is used for things like the intstaller.
LINUX_EXTRA_OPTIONS = "console=ttyS0,115200 console=tty0 shelltimeout=20"

#Since we can use this generic image with QEMU, also produce QED images, when possible.
IMAGE_FSTYPES += "qed"

MACHINE_FEATURES = "screen apm usbhost vfat"

#Assume a default root; though this should probably be
#detected and rewritten either by the installer, to
#expand compatibility to non-tablets.
DOM0_ROOT ?= "/dev/sda2"
```

## conf/machine/include/arm/arch-armv7ve.inc
```bitbake
#
# ARMv7 processors with Virtualization Extensions
#

DEFAULTTUNE ?= "armv7ve"

TUNEVALID[armv7ve] = "Enable instructions for ARMv7 processors with virtualization extensions"
TUNECONFLICTS[armv7ve] = "armv4 armv5 armv6 armv7 armv7a"
TUNE_CCARGS .= "${@bb.utils.contains("TUNE_FEATURES", "armv7ve", " -march=armv7ve", "", d)}"
MACHINEOVERRIDES =. "${@bb.utils.contains("TUNE_FEATURES", "armv7ve", "armv7ve:", "" ,d)}"

require conf/machine/include/arm/arch-armv7a.inc

# Little Endian base configs
AVAILTUNES += "armv7ve armv7vet armv7ve-neon armv7vet-neon"
ARMPKGARCH_tune-armv7ve ?= "armv7ve"
ARMPKGARCH_tune-armv7vet ?= "armv7ve"
ARMPKGARCH_tune-armv7ve-neon?= "armv7ve"
ARMPKGARCH_tune-armv7vet-neon ?= "armv7ve"
TUNE_FEATURES_tune-armv7ve ?= "arm armv7ve vfp"
TUNE_FEATURES_tune-armv7vet ?= "${TUNE_FEATURES_tune-armv7ve} thumb"
TUNE_FEATURES_tune-armv7ve-neon ?= "${TUNE_FEATURES_tune-armv7ve} neon"
TUNE_FEATURES_tune-armv7vet-neon ?= "${TUNE_FEATURES_tune-armv7vet} neon"
PACKAGE_EXTRA_ARCHS_tune-armv7ve = "${PACKAGE_EXTRA_ARCHS_tune-armv6} armv7ve armv7ve-vfp"
PACKAGE_EXTRA_ARCHS_tune-armv7ve-neon = "${PACKAGE_EXTRA_ARCHS_tune-armv7ve} armv7ve-vfp-neon"
PACKAGE_EXTRA_ARCHS_tune-armv7vet = "${PACKAGE_EXTRA_ARCHS_tune-armv6t} armv7ve armv7ve-vfp armv7vet2-vfp"
PACKAGE_EXTRA_ARCHS_tune-armv7vet-neon = "${PACKAGE_EXTRA_ARCHS_tune-armv7vet} armv7ve-vfp-neon armv7vet2-vfp-neon"

# VFP Tunes
AVAILTUNES += "armv7vehf armv7vethf armv7vehf-neon armv7vethf-neon armv7vehf-neon-vfpv4 armv7vethf-neon-vfpv4"
ARMPKGARCH_tune-armv7vehf ?= "armv7ve"
ARMPKGARCH_tune-armv7vethf ?= "armv7ve"
ARMPKGARCH_tune-armv7vehf-neon?= "armv7ve"
ARMPKGARCH_tune-armv7vethf-neon ?= "armv7ve"
ARMPKGARCH_tune-armv7vehf-neon-vfpv4 ?= "armv7ve"
ARMPKGARCH_tune-armv7vethf-neon-vfpv4 ?= "armv7ve"
TUNE_FEATURES_tune-armv7vehf ?= "${TUNE_FEATURES_tune-armv7ve} callconvention-hard"
TUNE_FEATURES_tune-armv7vethf ?= "${TUNE_FEATURES_tune-armv7vet} callconvention-hard"
TUNE_FEATURES_tune-armv7vehf-neon ?= "${TUNE_FEATURES_tune-armv7ve-neon} callconvention-hard"
TUNE_FEATURES_tune-armv7vethf-neon ?= "${TUNE_FEATURES_tune-armv7vet-neon} callconvention-hard"
TUNE_FEATURES_tune-armv7vehf-neon-vfpv4 ?= "${TUNE_FEATURES_tune-armv7vehf-neon} vfpv4"
TUNE_FEATURES_tune-armv7vethf-neon-vfpv4 ?= "${TUNE_FEATURES_tune-armv7vethf-neon} vfpv4"
PACKAGE_EXTRA_ARCHS_tune-armv7vehf = "${PACKAGE_EXTRA_ARCHS_tune-armv6hf} armv7vehf-vfp"
PACKAGE_EXTRA_ARCHS_tune-armv7vethf = "${PACKAGE_EXTRA_ARCHS_tune-armv6thf} armv7vehf-vfp armv7vet2hf-vfp"
PACKAGE_EXTRA_ARCHS_tune-armv7vehf-neon = "${PACKAGE_EXTRA_ARCHS_tune-armv7vehf} armv7vehf-vfp-neon"
PACKAGE_EXTRA_ARCHS_tune-armv7vethf-neon = "${PACKAGE_EXTRA_ARCHS_tune-armv7vethf} armv7vehf-vfp-neon armv7vet2hf-vfp-neon"
PACKAGE_EXTRA_ARCHS_tune-armv7vehf-neon-vfpv4 = "${PACKAGE_EXTRA_ARCHS_tune-armv7vehf-neon} armv7vehf-vfp-neon-vfpv4"
PACKAGE_EXTRA_ARCHS_tune-armv7vethf-neon-vfpv4 = "${PACKAGE_EXTRA_ARCHS_tune-armv7vethf-neon} armv7vehf-vfp-neon-vfpv4 armv7vet2hf-vfp-neon-vfpv4"

# Big Endian
AVAILTUNES += "armv7veb armv7vetb armv7veb-neon armv7vetb-neon"
ARMPKGARCH_tune-armv7veb ?= "armv7ve"
ARMPKGARCH_tune-armv7vetb ?= "armv7ve"
ARMPKGARCH_tune-armv7veb-neon?= "armv7ve"
ARMPKGARCH_tune-armv7vetb-neon ?= "armv7ve"
TUNE_FEATURES_tune-armv7veb ?= "${TUNE_FEATURES_tune-armv7ve} bigendian"
TUNE_FEATURES_tune-armv7vetb ?= "${TUNE_FEATURES_tune-armv7vet} bigendian"
TUNE_FEATURES_tune-armv7veb-neon ?= "${TUNE_FEATURES_tune-armv7ve-neon} bigendian"
TUNE_FEATURES_tune-armv7vetb-neon ?= "${TUNE_FEATURES_tune-armv7vet-neon} bigendian"
PACKAGE_EXTRA_ARCHS_tune-armv7veb = "${PACKAGE_EXTRA_ARCHS_tune-armv6b} armv7veb-vfp"
PACKAGE_EXTRA_ARCHS_tune-armv7vetb = "${PACKAGE_EXTRA_ARCHS_tune-armv6tb} armv7veb-vfp armv7vet2b-vfp"
PACKAGE_EXTRA_ARCHS_tune-armv7veb-neon = "${PACKAGE_EXTRA_ARCHS_tune-armv7veb} armv7veb-vfp-neon"
PACKAGE_EXTRA_ARCHS_tune-armv7vetb-neon = "${PACKAGE_EXTRA_ARCHS_tune-armv7vetb} armv7veb-vfp-neon armv7vet2b-vfp-neon"

# Big Endian + VFP
AVAILTUNES += "armv7vehfb armv7vethfb armv7vehfb-neon armv7vethfb-neon"
ARMPKGARCH_tune-armv7vehfb ?= "armv7ve"
ARMPKGARCH_tune-armv7vethfb ?= "armv7ve"
ARMPKGARCH_tune-armv7vehfb-neon?= "armv7ve"
ARMPKGARCH_tune-armv7vethfb-neon ?= "armv7ve"
TUNE_FEATURES_tune-armv7vehfb ?= "${TUNE_FEATURES_tune-armv7vehf} bigendian"
TUNE_FEATURES_tune-armv7vethfb ?= "${TUNE_FEATURES_tune-armv7vethf} bigendian"
TUNE_FEATURES_tune-armv7vehfb-neon ?= "${TUNE_FEATURES_tune-armv7vehf-neon} bigendian"
TUNE_FEATURES_tune-armv7vethfb-neon ?= "${TUNE_FEATURES_tune-armv7vethf-neon} bigendian"
PACKAGE_EXTRA_ARCHS_tune-armv7vehfb = "${PACKAGE_EXTRA_ARCHS_tune-armv6hfb} armv7vehfb-vfp"
PACKAGE_EXTRA_ARCHS_tune-armv7vethfb = "${PACKAGE_EXTRA_ARCHS_tune-armv6thfb} armv7vehfb-vfp armv7vet2hfb-vfp"
PACKAGE_EXTRA_ARCHS_tune-armv7vehfb-neon = "${PACKAGE_EXTRA_ARCHS_tune-armv7vehfb} armv7vehfb-vfp-neon"
PACKAGE_EXTRA_ARCHS_tune-armv7vethfb-neon = "${PACKAGE_EXTRA_ARCHS_tune-armv7vethfb} armv7vehfb-vfp-neon armv7vet2hfb-vfp-neon"
```

## conf/machine/include/arm/arm-xen.inc
```bitbake
PREFERRED_PROVIDER_virtual/bootloader = "u-boot"

#Ensure that we get a version of u-boot that's new enough to properly 
#support the virtualization extensions.
PREFERRED_VERSION_u-boot = "v2015.04%"

#The sunxi-u-boot can boot both uImages and zImages, so we'll
#use the more standard format. Note Xen loads zImages, so
#KERNEL_IMAGETYPE should always be zImage for a dom0 platform.
XEN_IMAGETYPE    = "zImage"
KERNEL_IMAGETYPE = "zImage"

IMAGE_FSTYPES += "ext4"

MACHINE_EXTRA_RRECOMMENDS = "kernel-modules"

UBOOT_ARCH           = "arm"

UBOOT_BOOT_DEVICE    ?= "mmc"
UBOOT_BOOT_PARTITION ?= "0"
UBOOT_DOM0_ROOT      ?= "/dev/mmcblk0p2"

#TODO: Possibly decrease, depending on dom0's requirements?
XEN_DOM0_MEMORY      ?= "128M"

DOM0_EXTRA_BOOTARGS  ?= "rootwait"
XEN_EXTRA_BOOTARGS   ?= "loglvl=all"
XEN_SERIAL_PORT      ?= "ttyS0"
```

## conf/machine/include/sunxi-mali.inc
```bitbake
PREFERRED_PROVIDER_virtual/mesa ?= "mesa-gl"
PREFERRED_PROVIDER_virtual/libgl ?= "mesa-gl"
PREFERRED_PROVIDER_virtual/libgles1 ?= "sunxi-mali"
PREFERRED_PROVIDER_virtual/libgles2 ?= "sunxi-mali"
PREFERRED_PROVIDER_virtual/egl ?= "sunxi-mali"

#Override the meta-sunxi logic that restricts use of sunxi-mali to the
#machines in the meta-sunxi layer. Instead, we'll allow machines that
#include this file to build sunxi-mali, as well.
COMPATIBLE_MACHINE_pn-sunxi-mali .= "(${MACHINE})"

XSERVER = " \
    xserver-xorg \
    xf86-video-fbturbo \
    xf86-input-evdev \
    xf86-input-mouse \
    xf86-input-keyboard \
    sunxi-mali \
    sunxi-mali-dev \
"
MACHINE_ESSENTIAL_EXTRA_RRECOMMENDS += "\
 kernel-module-mali \
 kernel-module-mali-drm \
"
```

## conf/machine/include/sunxi-xen.inc
```bitbake
#Require the main Xen configuration for ARM machines running Xen.
require conf/machine/include/arm/arm-xen.inc

BOOTLOADER_START = "8192"
```

## conf/machine/include/x86-xen.inc
```bitbake
# Copyright (C) 2015 Assured Information Security, Inc.
# Author: Kyle J. Temkin <temkink@ainfosec.com>
#
# Released under the MIT license (see COPYING.MIT for the terms)
#
# Base Xen platform, including a simple dom0.
#

KERNEL_IMAGETYPE = "bzImage"
XEN_IMAGETYPE = "gzip"

#Use a dynamically populated devfs, rather than a device tree on x86.
USE_DEVFS = "1"
```

## conf/machine/primo73.conf
```bitbake
#@TYPE: Machine
#@NAME: Primo73
#@DESCRIPTION: Machine configuration for the Primo73 running Xen

DEFAULTTUNE ?= "armv7vehf-neon"

require conf/machine/include/arm/arch-armv7ve.inc
require conf/machine/include/sunxi-xen.inc
require conf/machine/include/sunxi-mali.inc

KERNEL_DEVICETREE = "sun7i-a20-${MACHINE}.dtb"

UBOOT_MACHINE     = "MSI_Primo73"
UBOOT_ENTRYPOINT  = "0x40008000"
UBOOT_LOADADDRESS = "0x40008000"

#TODO: Possibly relocate me (and some of the above?) to an include file?
SPL_BINARY = "u-boot-sunxi-with-spl.bin"

#Set up the locations into which u-boot should load the kernel components.
#These are appropriate for the 1GiB of RAM on the MSI Primo 73.
#TODO: Generate me automatically!
UBOOT_DOM0_ADDR   = "0x7c600000"
UBOOT_DTB_ADDR    = "0x74c00000"
UBOOT_XEN_ADDR    = "0x72a00000"

#Specify the serial console that the non-Xen entities (bootloaders, installers)
#should use.
SERIAL_CONSOLE    = "115200 ttyS0"

#Specify the methods  by which Xen will communicate with the outside world.
XEN_SERIAL_PORT   = "/soc@01c00000/serial@01c28000"
XEN_EARLYPRINTK   = "sun7i"

#... and specify the default amount of memory to provide to domain zero.
XEN_DOM0_MEMORY   = "128M"

MACHINE_FEATURES  = "screen apm usbgadget usbhost vfat"
```

## conf/machine/surface-pro-3-usb.conf
```bitbake
#@TYPE: Machine
#@NAME: Generic-x86-Xen
#@DESCRIPTION: Generic machine for Xen on x86 with EFI-only firmware.

GUI_MACHINE_CLASS = "bigscreen"

#TODO: Should this be tune-x86_64?
require conf/machine/include/tune-x86_64.inc
require conf/machine/include/x86-xen.inc

SERIAL_CONSOLE = "115200 ttyS0"

XEN_SERIAL_PORT    = "115200,8n1"
XEN_DOM0_MEMORY    = "256M"
XEN_EXTRA_BOOTARGS = "noreboot vga=keep"

MACHINE_FEATURES = "screen apm usbhost vfat efi"

#Assume a default root; though this should probably be
#detected and rewritten either by the installer, to
#expand compatibility to non-tablets.
DOM0_ROOT ?= "/dev/sdb2"
DOM0_EXTRA_BOOTARGS = "rootwait"
```

## conf/machine/surface-pro-3.conf
```bitbake
#@TYPE: Machine
#@NAME: Generic-x86-Xen
#@DESCRIPTION: Generic machine for Xen on x86 with EFI-only firmware.

GUI_MACHINE_CLASS = "bigscreen"

#Some information about the machine, as typically used by the installer.
MACHINE_NAME = "Surface Pro 3"
DEFAULT_INSTALLATION_DRIVE = "/dev/sdb"

#Run our installation in an decreased resolution, as the high DPI screens
#make it difficult to read the installer text otherwise!
INSTALLATION_BOOT_ARGUMENTS = "video=1152x768"

require conf/machine/include/tune-x86_64.inc
require conf/machine/include/x86-xen.inc

SERIAL_CONSOLE = "115200 ttyS0"

XEN_SERIAL_PORT    = "115200,8n1"
XEN_DOM0_MEMORY    = "256M"
XEN_EXTRA_BOOTARGS = "noreboot"

MACHINE_FEATURES = "screen apm usbhost vfat efi"

#Note: for now, we're booting with decreased resolution
#in the initial KMS, so the text is readable. This may be
#overridden by the display handler, evetually, or we may
#choose to modify this.
DOM0_ROOT ?= "/dev/sdb2"
DOM0_EXTRA_BOOTARGS = "rootwait video=1152x768"
```
